## rtl819x/users/samba/Kconfig
```kconfig
#
# samba version configuration
#

menuconfig APP_SAMBA
	bool "samba support"
	default n
	---help---
	Enable samba server
if APP_SAMBA
choice
	prompt "samba version"
	default APP_SAMBA-3.2.15
	config APP_SAMBA-3.0.24
		bool "samba-3.0.24"
	config APP_SAMBA-3.2.15
		bool "samba-3.2.15"
	config APP_SAMBA-3.6.24
		bool "samba-3.6.24"
endchoice

config	APP_SAMBA_WEB
	bool "samba web support"
	default n
	
config SAMBA_LOG_SUPPORT
    bool "samba log support"
    depends on APP_SAMBA-3.2.15 || APP_SAMBA-3.6.24
    default n
    help
    Enable samba log support

endif
```
